/ {
  behaviors {
    // Reset tap dance - now working in modern ZMK
    reset_td: reset_td {
      compatible = "zmk,behavior-tap-dance";
      label = "RESET_TD";
      #binding-cells = <0>;
      tapping-term-ms = <200>;
      bindings = <&sys_reset>, <&bootloader>;
    };
  };
};
