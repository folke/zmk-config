#if defined(NICE_VIEW_SPI)
&nice_view_spi {
    cs-gpios = <NICE_VIEW_SPI>;
};
#endif

&mt {
  tapping-term-ms = <200>;
};

&lt {  // layer-tap config
  flavor = "balanced";
  tapping-term-ms = <200>;
  quick-tap-ms = <175>;
};

